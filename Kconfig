## Kconfig
```kconfig
# Copyright (c) 2024 The ZMK Contributors
# SPDX-License-Identifier: MIT

config NICE_VIEW_VCOM_KEEPALIVE
    bool "Periodically refresh the nice!view to keep its VCOM toggling"
    depends on ZMK_DISPLAY
    help
      Forces a full-screen redraw of the nice!view display on a fixed interval.
      Sharp memory-in-pixel (MIP) panels need VCOM toggled regularly or the
      image decays into garbage; the ls0xx driver only toggles VCOM when ZMK
      sends a frame. On a split peripheral the widget rarely updates, so this
      keeps the panel refreshed. Enabled automatically by the nice_view_mip
      shield.

config NICE_VIEW_VCOM_KEEPALIVE_INTERVAL_MS
    int "nice!view VCOM keepalive interval (ms)"
    depends on NICE_VIEW_VCOM_KEEPALIVE
    default 1000
    help
      How often to force a full-screen redraw. Lower is safer for the panel but
      costs a little more power. Raise it if the image stays clean at a larger
      value.
```

## boards/shields/nice_view_mip/Kconfig.shield
```kconfig
# Copyright (c) 2024 The ZMK Contributors
# SPDX-License-Identifier: MIT

config SHIELD_NICE_VIEW_MIP
    def_bool $(shields_list_contains,nice_view_mip)
```

## boards/shields/sofle_dongle/Kconfig.defconfig
```kconfig
if SHIELD_SOFLE_DONGLE

config ZMK_KEYBOARD_NAME
    default "Sofle"

config ZMK_SPLIT_ROLE_CENTRAL
    default y

endif # SHIELD_SOFLE_DONGLE
```
