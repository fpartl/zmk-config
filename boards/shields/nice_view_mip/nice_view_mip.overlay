/*
 * Copyright (c) 2024 The ZMK Contributors
 * SPDX-License-Identifier: MIT
 *
 * Fix for the MIP variant of the nice!view display, which uses a different
 * chip-select pin than the stock nice!view. See:
 * https://guides-mechboards.gitbook.io/guides/firmware/mip-nice-view-display-config
 *
 * This is a separate shield (instead of living in the keymap) so the override
 * is only applied to builds that actually include the nice_view_adapter shield
 * (the keyboard halves). The dongle build has no nice_view_spi node, so adding
 * this override to the shared keymap would break its devicetree build.
 */

#include <dt-bindings/gpio/gpio.h>

&nice_view_spi {
    cs-gpios = <&pro_micro 4 GPIO_ACTIVE_HIGH>;
};
